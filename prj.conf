## CMakeLists.txt
```
cmake_minimum_required(VERSION 3.13.1)

set(BOARD_ROOT ${CMAKE_CURRENT_SOURCE_DIR}/.)

if(NOT DEFINED BOARD)
    set(BOARD "nrf52840dk/nrf52840")
endif()

find_package(Zephyr REQUIRED HINTS $ENV{ZEPHYR_BASE})
project(zephyr-link-tic)

set(app_sources
    src/main.c
    src/tic.c
)

target_include_directories(app PRIVATE include)
target_sources(app PRIVATE ${app_sources})
target_sources_ifdef(CONFIG_BT app PRIVATE src/ble.c)
target_sources_ifdef(CONFIG_TIC_DEMO_MODE app PRIVATE 
    src/tic_demo.c
    src/tic_demo_data.c
)
```

## Kconfig
```
config TIC_DEMO_MODE
    bool "Enable Demo Mode"
    default n
    help
     Enable demo mode for the TIC module. In demo mode, predefined data is used instead of real data from the TIC module.
     This is useful for testing and development purposes.

choice TIC_ADV_INTERVAL
    prompt "TIC BLE Advertising Interval"
    default TIC_ADV_SLOW
    help
     Select the advertising interval for the TIC BLE advertisements.

config TIC_ADV_FAST1
    bool "30 - 60 ms"
    help
     Set the advertising interval to 30 - 60 ms.

config TIC_ADV_FAST2
    bool "100 - 150 ms"
    help
     Set the advertising interval to 100 - 150 ms.

config TIC_ADV_SLOW
    bool "1s - 1.2s"
    help
     Set the advertising interval to 1s - 1.2s.

endchoice

menu "Zephyr RTOS Configuration"

source "Kconfig.zephyr"

endmenu
```

## west.yml
```
# Copyright (c) 2020 Lucas Dietrich (ld.adecy@gmail.com)
# SPDX-License-Identifier: Apache-2.0

manifest:
  self:
    path: zephyr-link-tic

  remotes:
    - name: zephyrproject-rtos
      url-base: https://github.com/zephyrproject-rtos
    - name: zephyrproject-rtos-fork
      url-base: https://github.com/lucasdietrich

  projects:
    - name: zephyr
      remote: zephyrproject-rtos-fork
      revision: fix/tcp-keep-alive
      import: true
```

## prj.conf
```kconfig
CONFIG_KERNEL_BIN_NAME="ble-linky-tic"

CONFIG_PRINTK=y
CONFIG_LOG=y

CONFIG_THREAD_NAME=y
CONFIG_INIT_STACKS=y
CONFIG_THREAD_STACK_INFO=y
CONFIG_MPU_STACK_GUARD=y

CONFIG_USB_DEVICE_STACK=y

CONFIG_USB_DEVICE_PRODUCT="BLE Linux Linky TIC"
CONFIG_USB_DEVICE_VID=0x2FE3
CONFIG_USB_DEVICE_PID=0x0100

CONFIG_USB_DRIVER_LOG_LEVEL_INF=y
CONFIG_USB_DEVICE_LOG_LEVEL_INF=y

CONFIG_POSIX_API=y

CONFIG_LOG_BUFFER_SIZE=4096

# CONFIG_UART_USE_RUNTIME_CONFIGURE=y

CONFIG_SERIAL=y
CONFIG_UART_ASYNC_API=y

CONFIG_POLL=y
CONFIG_ASSERT=y

CONFIG_BT=y
# CONFIG_BT_SMP=y
CONFIG_BT_PERIPHERAL=y
CONFIG_BT_EXT_ADV=y

# Increase Advertising Data Length, as Complete Local Name too needs to be
# placed in the AUX_ADV_IND PDU compared to when it is placed in ADV_SCAN_IND
# PDU in the case of legacy advertising.
CONFIG_BT_CTLR_ADV_DATA_LEN_MAX=36

# CONFIG_BT_DIS=y
CONFIG_BT_DEVICE_NAME="Linky TIC"

# 0x0557 (1367) # Energy Meter
CONFIG_BT_DEVICE_APPEARANCE=1367

CONFIG_CBPRINTF_FP_SUPPORT=y

CONFIG_TIC_DEMO_MODE=n
CONFIG_TIC_ADV_FAST2=y
```

## boards/nrf52840dk_nrf52840.overlay
```dts
&uart1 {
    status = "okay";
    current-speed = <1200>;
    parity = "even";
    stop-bits = "1";
    data-bits = <7>;
};
```

## src/main.c
```c
/*
 * Copyright (c) 2025 Lucas Dietrich <ld.adecy@gmail.com>
 *
 * SPDX-License-Identifier: Apache-2.0
 */

#include "ble.h"
#include "tic.h"

#include <zephyr/drivers/uart.h>
#include <zephyr/kernel.h>
#include <zephyr/logging/log.h>

LOG_MODULE_REGISTER(main, LOG_LEVEL_INF);

#define UART_DEVICE_NODE DT_NODELABEL(uart1)
static const struct device *const uart_dev = DEVICE_DT_GET(UART_DEVICE_NODE);

#define RX_CHUNK_LEN	64
#define RX_RINGBUF_SIZE 1024

K_SEM_DEFINE(rx_enable_sem, 1, 1);
K_SEM_DEFINE(rx_data_sem, 0, 1);
uint8_t async_rx_buffer[2u][RX_CHUNK_LEN];
volatile uint8_t async_rx_buffer_idx = 0;
RING_BUF_DECLARE(uart_rx_ringbuf, RX_RINGBUF_SIZE);

#if !defined(CONFIG_TIC_DEMO_MODE)
static void
uart_callback(const struct device *dev, struct uart_event *evt, void *user_data)
{
	int rc;
	uint32_t written;

	switch (evt->type) {
	case UART_RX_BUF_REQUEST:
		/* Return the next buffer index */
		rc = uart_rx_buf_rsp(
			dev, async_rx_buffer[async_rx_buffer_idx], sizeof(async_rx_buffer[0]));
		__ASSERT_NO_MSG(rc == 0);
		async_rx_buffer_idx = async_rx_buffer_idx ? 0 : 1;
		break;
	case UART_RX_BUF_RELEASED:
		break;
	case UART_RX_DISABLED:
		LOG_WRN("RX disabled");
		async_rx_buffer_idx = 0;
		k_sem_give(&rx_enable_sem);
		break;
	case UART_RX_RDY:
		written = ring_buf_put(
			&uart_rx_ringbuf, evt->data.rx.buf + evt->data.rx.offset, evt->data.rx.len);
		if (written != evt->data.rx.len) {
			LOG_WRN("Received bytes dropped from ring buf");
		}
		/* Notify upper layer that new data has arrived */
		k_sem_give(&rx_data_sem);
		break;
	case UART_RX_STOPPED:
		LOG_WRN("RX stopped, reason %d", evt->data.rx_stop.reason);
		break;
	case UART_TX_DONE:
	case UART_TX_ABORTED:
	default:
		LOG_WRN("Unhandled event %d", evt->type);
		break;
	}
}
#endif

struct tic_infos {
	tic_mode_t mode;
	union {
		tic_hist_t hist;
	};
	struct {
		uint64_t rx_bytes;
		uint32_t rx_datasets;
		uint32_t checksum_err;
	} stats;
};

static struct tic_infos tic_infos = {
	.mode = TIC_MODE_HISTORIQUE,
};

void tc_cb(tic_status_t err, const char *label, const char *data, void *user_data)
{
	if (err == TIC_STATUS_ERR_CHECKSUM) {
		tic_infos.stats.checksum_err++;
	} else if (err == TIC_STATUS_EOF) {
		LOG_INF("TIC PAPP: %u W IINST: %u A (IMAX %u A ISOUSC %u) BASE %u Wh - ADCO "
				"%.12s (rx B: %llu N dt: %u C err: %u)",
				tic_infos.hist.papp,
				tic_infos.hist.iinst,
				tic_infos.hist.imax,
				tic_infos.hist.isousc,
				tic_infos.hist.base,
				tic_infos.hist.adco,
				tic_infos.stats.rx_bytes,
				tic_infos.stats.rx_datasets,
				tic_infos.stats.checksum_err);
	} else if (err == TIC_STATUS_DATASET) {
		LOG_DBG("TIC %s:%s [%d]", label, data, err);
		tic_infos.stats.rx_datasets++;

		int ret = tic_hist_parse_data(&tic_infos.hist, label, data);
		if (ret == 0) {
			/* If value changed, update advertising data */
			ble_update_adv(&tic_infos.hist);
		} else {
			LOG_WRN("Failed to parse TIC data %s:%s (%d)", label, data, ret);
		}
	}
}

int main(void)
{
	int ret;
	static uint8_t buf[128];
	LOG_INF("Linky TIC reader started");

	if (!device_is_ready(uart_dev)) {
		LOG_ERR("UART device not found!");
		return 0;
	}

	struct tic tic;
	ret = tic_init(&tic, tc_cb, (void *)&tic_infos);
	if (ret != 0) {
		LOG_ERR("Failed to initialize TIC: %d", ret);
		return 0;
	}

#if !defined(CONFIG_TIC_DEMO_MODE)
	/* Register the async interrupt handler */
	ret = uart_callback_set(uart_dev, uart_callback, (void *)uart_dev);
	if (ret != 0) {
		LOG_ERR("Failed to set UART callback: %d", ret);
		return 0;
	}
#endif /* !CONFIG_TIC_DEMO_MODE */

#if defined(CONFIG_BT)
	ret = ble_init();
	if (ret != 0) {
		LOG_ERR("Failed to initialize BLE: %d", ret);
		return 0;
	}
#endif /* CONFIG_BT */

	struct k_poll_event events[] = {
		K_POLL_EVENT_INITIALIZER(
			K_POLL_TYPE_SEM_AVAILABLE, K_POLL_MODE_NOTIFY_ONLY, &rx_data_sem),
		K_POLL_EVENT_INITIALIZER(
			K_POLL_TYPE_SEM_AVAILABLE, K_POLL_MODE_NOTIFY_ONLY, &rx_enable_sem),
	};

	for (;;) {
		events[0].state = K_POLL_STATE_NOT_READY;
		events[1].state = K_POLL_STATE_NOT_READY;

		ret = k_poll(events, ARRAY_SIZE(events), K_FOREVER);
		if (ret == 0) {
			if (events[0].state == K_POLL_STATE_SEM_AVAILABLE) {
				ret = k_sem_take(&rx_data_sem, K_NO_WAIT);
				__ASSERT(ret == 0, "Failed to take rx_data_sem");
				uint32_t read;
				while ((read = ring_buf_get(&uart_rx_ringbuf, buf, sizeof(buf))) > 0) {
					tic_infos.stats.rx_bytes += read;
					for (uint32_t i = 0; i < read; i++) {
						tic_data_in(&tic, buf[i]);
					}
				}
			}

			if (events[1].state == K_POLL_STATE_SEM_AVAILABLE) {
				ret = k_sem_take(&rx_enable_sem, K_NO_WAIT);
				__ASSERT(ret == 0, "Failed to take rx_enable_sem");
				LOG_INF("Enabling RX");
				ring_buf_reset(&uart_rx_ringbuf);
				k_sem_reset(&rx_data_sem);
				ret = uart_rx_enable(uart_dev,
									 async_rx_buffer[async_rx_buffer_idx],
									 RX_CHUNK_LEN,
									 SYS_FOREVER_US);
				if (ret != 0) {
					LOG_ERR("Failed to enable RX: %d", ret);
				}
			}
		}
	}

	return 0;
}
```

## include/ble.h
```c
/*
 * Copyright (c) 2025 Lucas Dietrich <ld.adecy@gmail.com>
 *
 * SPDX-License-Identifier: Apache-2.0
 */

#ifndef _BLE_H
#define _BLE_H

#include "tic.h"

#include <zephyr/kernel.h>

int ble_init(void);

int ble_update_adv(const tic_hist_t *hist);

#endif /* _BLE_H */
```

## include/tic.h
```c
/*
 * Copyright (c) 2025 Lucas Dietrich <ld.adecy@gmail.com>
 *
 * SPDX-License-Identifier: Apache-2.0
 */

#ifndef _TIC_H
#define _TIC_H

#include <stddef.h>
#include <stdint.h>

#define TIC_LABEL_MAX_LEN 8u
#define TIC_DATA_MAX_LEN  12u

#define TIC_LABEL_ADCO	   "ADCO"
#define TIC_LABEL_ISOUSC   "ISOUSC"
#define TIC_LABEL_BASE	   "BASE"
#define TIC_LABEL_PTEC	   "PTEC"
#define TIC_LABEL_IINST	   "IINST"
#define TIC_LABEL_IMAX	   "IMAX"
#define TIC_LABEL_PAPP	   "PAPP"
#define TIC_LABEL_HHPHC	   "HHPHC"
#define TIC_LABEL_MOTDETAT "MOTDETAT"
#define TIC_LABEL_OPTARIF  "OPTARIF"
#define TIC_LABEL_HHPHC	   "HHPHC"
#define TIC_LABEL_MOTDETAT "MOTDETAT"

#define TIC_HIST_DATA_OPTARIF_EXPECTED	"BASE"
#define TIC_HIST_DATA_HHPHC_EXPECTED	"A"
#define TIC_HIST_DATA_MOTDETAT_EXPECTED "000000"

#define TIC_LABEL_SIZE(_label) (sizeof(_label) - 1u)

#define TIC_ADCO_DATA_LEN 12u

typedef enum tic_mode {
	TIC_MODE_HISTORIQUE = 0,
	TIC_MODE_STANDARD,
} tic_mode_t;

typedef enum tic_status {
	TIC_STATUS_DATASET = 0,
	TIC_STATUS_EOF,
	TIC_STATUS_ERR_CHECKSUM
} tic_status_t;

typedef void (*tic_callback_t)(tic_status_t err,
							   const char *label,
							   const char *data,
							   void *user_data);

typedef enum tic_state {
	TIC_WF,		  // Waiting for start of frame (STX)
	TIC_WD,		  // Waiting for start of dataset (LF)
	TIC_LABEL,	  // Parsing label
	TIC_DATA,	  // Parsing data
	TIC_CHECKSUM, // Parsing checksum
	TIC_EOD,	  // Waiting for end of dataset (CR)
} tic_state_t;

typedef struct tic {
	tic_callback_t callback;
	void *user_data;
	tic_state_t state;
	size_t w_cursor;
	unsigned char calc_checksum;
	char label[TIC_LABEL_MAX_LEN + 1];
	char data[TIC_DATA_MAX_LEN + 1];
} tic_t;

int tic_init(tic_t *tic, tic_callback_t callback, void *user_data);

int tic_data_in(tic_t *tic, unsigned char chr);

typedef struct tic_hist {
	char adco[TIC_ADCO_DATA_LEN]; // CONST
	uint16_t isousc;			  // CONST
	uint32_t base;				  // VARIABLE
	uint16_t ptec;				  // VARIABLE
	uint16_t iinst;				  // VARIABLE
	uint16_t imax;				  // CONST
	uint16_t papp;				  // VARIABLE
} tic_hist_t;

// 12 + 2 + 4 + 2 + 2 + 2 + 4

int tic_hist_parse_data(tic_hist_t *hist, const char *label, const char *data);

#endif /* _TIC_H */
```

## src/ble.c
```c
/*
 * Copyright (c) 2025 Lucas Dietrich <ld.adecy@gmail.com>
 *
 * SPDX-License-Identifier: Apache-2.0
 */

/* main.c - Application main entry point */

/*
 * Copyright (c) 2019 Aaron Tsui <aaron.tsui@outlook.com>
 *
 * SPDX-License-Identifier: Apache-2.0
 */

#include "tic.h"
#include "zephyr/logging/log.h"
#include "zephyr/sys/time_units.h"

#include <errno.h>
#include <stddef.h>
#include <string.h>

#include <zephyr/bluetooth/bluetooth.h>
#include <zephyr/bluetooth/conn.h>
#include <zephyr/bluetooth/gatt.h>
#include <zephyr/bluetooth/hci.h>
#include <zephyr/bluetooth/services/bas.h>
#include <zephyr/bluetooth/uuid.h>
#include <zephyr/kernel.h>
#include <zephyr/sys/byteorder.h>
#include <zephyr/sys/printk.h>
#include <zephyr/types.h>

LOG_MODULE_REGISTER(ble, LOG_LEVEL_DBG);

#define TIC_HIST_ADV_DATA_LEN 11u
#define TIC_HIST_SD_DATA_LEN  17u

static uint8_t energy_meter_ad_data[2u + TIC_HIST_ADV_DATA_LEN] = {0xff, 0xff};
static uint8_t energy_meter_sd_data[2u + TIC_HIST_SD_DATA_LEN]	= {0xff, 0xff};

static const struct bt_data ad[] = {
	BT_DATA_BYTES(BT_DATA_FLAGS, (BT_LE_AD_GENERAL | BT_LE_AD_NO_BREDR)),
	BT_DATA(
		BT_DATA_NAME_COMPLETE, CONFIG_BT_DEVICE_NAME, sizeof(CONFIG_BT_DEVICE_NAME) - 1),
	BT_DATA(
		BT_DATA_MANUFACTURER_DATA, energy_meter_ad_data, sizeof(energy_meter_ad_data)),
};

const struct bt_data sd[] = {
	BT_DATA(
		BT_DATA_MANUFACTURER_DATA, energy_meter_sd_data, sizeof(energy_meter_sd_data)),
};

static int tic_hist_ser_ad(const tic_hist_t *hist, uint8_t *adbuf, size_t buf_len)
{
	if (!hist || !adbuf || buf_len < TIC_HIST_ADV_DATA_LEN) {
		return -EINVAL;
	}

	adbuf[0] = TIC_MODE_HISTORIQUE;
	sys_put_le32(hist->base, &adbuf[1]);
	sys_put_le16(hist->iinst, &adbuf[5]);
	sys_put_le16(hist->ptec, &adbuf[7]);
	sys_put_le16(hist->papp, &adbuf[9]);

	return 0;
}

static int tic_hist_ser_sd(const tic_hist_t *hist, uint8_t *sdbuf, size_t buf_len)
{
	if (!hist || !sdbuf || buf_len < TIC_HIST_SD_DATA_LEN) {
		return -EINVAL;
	}

	sdbuf[0] = TIC_MODE_HISTORIQUE;
	memcpy(&sdbuf[1], hist->adco, TIC_ADCO_DATA_LEN);
	sys_put_le16(hist->isousc, &sdbuf[13]);
	sys_put_le16(hist->imax, &sdbuf[15]);

	return 0;
}

#define ADV_PARAM                                                                        \
	BT_LE_ADV_PARAM(0, BT_GAP_ADV_FAST_INT_MIN_1, BT_GAP_ADV_FAST_INT_MAX_1, NULL)

int ble_init(void)
{
	int err;

	err = bt_enable(NULL);
	if (err) {
		LOG_ERR("Bluetooth init failed (err %d)\n", err);
		return 0;
	}

	struct bt_le_adv_param params = {0};

	params.id				  = BT_ID_DEFAULT;
	params.sid				  = 0;
	params.secondary_max_skip = 0;
	params.options			  = BT_LE_ADV_OPT_SCANNABLE | BT_LE_ADV_OPT_NOTIFY_SCAN_REQ;
#if defined(CONFIG_TIC_ADV_FAST1)
	params.interval_min = BT_GAP_ADV_FAST_INT_MIN_1;
	params.interval_max = BT_GAP_ADV_FAST_INT_MAX_1;
#elif defined(CONFIG_TIC_ADV_FAST2)
	params.interval_min = BT_GAP_ADV_FAST_INT_MIN_2;
	params.interval_max = BT_GAP_ADV_FAST_INT_MAX_2;
#else
	params.interval_min = BT_GAP_ADV_SLOW_INT_MIN;
	params.interval_max = BT_GAP_ADV_SLOW_INT_MAX;
#endif
	params.peer = NULL;

	err = bt_le_adv_start(&params, ad, ARRAY_SIZE(ad), sd, ARRAY_SIZE(sd));
	if (err) {
		LOG_ERR("Advertising failed to start (err %d)\n", err);
		return err;
	}

	return err;
}

int ble_update_adv(const tic_hist_t *hist)
{
	int err;

	err = tic_hist_ser_ad(hist, &energy_meter_ad_data[2u], TIC_HIST_ADV_DATA_LEN);
	if (err) {
		LOG_ERR("Failed to serialize TIC historique data for advertising (err %d)\n",
				err);
		return err;
	}

	err = tic_hist_ser_sd(hist, &energy_meter_sd_data[2u], TIC_HIST_SD_DATA_LEN);
	if (err) {
		LOG_ERR("Failed to serialize TIC historique data for scan response (err %d)\n",
				err);
		return err;
	}

	err = bt_le_adv_update_data(ad, ARRAY_SIZE(ad), sd, ARRAY_SIZE(sd));
	if (err) {
		LOG_ERR("Failed to update advertising data (err %d)\n", err);
		return err;
	}

	return 0;
}
```

## src/tic.c
```c
/*
 * Copyright (c) 2025 Lucas Dietrich <ld.adecy@gmail.com>
 *
 * SPDX-License-Identifier: Apache-2.0
 */

#include <stdlib.h>

#include <zephyr/kernel.h>
#include <zephyr/logging/log.h>

#include <sys/errno.h>
#include <tic.h>

LOG_MODULE_REGISTER(tic, LOG_LEVEL_WRN);

#define TIC_LF	0x0A
#define TIC_CR	0x0D
#define TIC_SP	0x20
#define TIC_HT	0x09
#define TIC_ETX 0x03
#define TIC_STX 0x02

int tic_init(tic_t *tic, tic_callback_t callback, void *user_data)
{
	if (!tic || !callback) {
		return -1;
	}

	tic->state	   = TIC_WF;
	tic->callback  = callback;
	tic->user_data = user_data;
	tic->w_cursor  = 0;

	return 0;
}

static void tic_reset(tic_t *tic)
{
	tic->state = TIC_WF;
}

bool is_printable(char c)
{
	return (c >= 0x20 && c <= 0x7E);
}

int tic_data_in(tic_t *tic, unsigned char chr)
{
	chr &= 0x7F; // Ensure 7-bit data

	switch (tic->state) {
	case TIC_WF:
		if (chr == TIC_STX) {
			tic->state = TIC_WD;
		}
		break;
	case TIC_WD:
		if (chr == TIC_LF) {
			tic->state		   = TIC_LABEL;
			tic->w_cursor	   = 0;
			tic->calc_checksum = 0;
		} else if (chr == TIC_ETX) {
			tic->callback(TIC_STATUS_EOF, NULL, NULL, tic->user_data);
			tic->state = TIC_WF;
		} else {
			LOG_WRN("Unexpected char while waiting for LF: %x", chr);
			tic_reset(tic);
		}
		break;
	case TIC_LABEL:
		if (chr == TIC_SP) {
			tic->state				  = TIC_DATA;
			tic->label[tic->w_cursor] = '\0';
			tic->w_cursor			  = 0;
			tic->calc_checksum += chr;
		} else if (tic->w_cursor < TIC_LABEL_MAX_LEN) {
			tic->label[tic->w_cursor++] = (char)chr;
			tic->calc_checksum += chr;
		} else {
			// TODO issue callback error
			LOG_WRN("Label size overflow %u > %u, new char: %c (%x)",
					tic->w_cursor + 1u,
					TIC_LABEL_MAX_LEN,
					is_printable(chr) ? (char)chr : '.',
					chr);
			LOG_HEXDUMP_WRN(tic->label, tic->w_cursor, "Label so far:");
			tic_reset(tic);
		}
		break;
	case TIC_DATA:
		if (chr == TIC_SP) {
			tic->state				 = TIC_CHECKSUM;
			tic->data[tic->w_cursor] = '\0';
		} else if (tic->w_cursor < TIC_DATA_MAX_LEN) {
			tic->data[tic->w_cursor++] = (char)chr;
			tic->calc_checksum += chr;
		} else {
			// TODO issue callback error
			LOG_WRN("Data size overflow %u > %u", tic->w_cursor, TIC_DATA_MAX_LEN);
			tic_reset(tic);
		}
		break;
	case TIC_CHECKSUM:
		tic->calc_checksum = (tic->calc_checksum & 0x3F) + 0x20;
		if (tic->calc_checksum != chr) {
			LOG_WRN("Checksum error for %s: calc %x != recv %x",
					tic->label,
					tic->calc_checksum,
					chr);
			// TODO issue callback error
			tic->callback(TIC_STATUS_ERR_CHECKSUM, NULL, NULL, tic->user_data);
			tic_reset(tic);
			break;
		}
		tic->state = TIC_EOD;
		break;
	case TIC_EOD:
		if (chr == TIC_CR) {
			tic->callback(TIC_STATUS_DATASET, tic->label, tic->data, tic->user_data);
			tic->state = TIC_WD;
		} else {
			// TODO issue callback error
			LOG_WRN("Unexpected EOF: %x", chr);
			tic_reset(tic);
		}
		break;
	default:
		break;
	}

	return 0;
}

int tic_hist_parse_data(tic_hist_t *hist, const char *label, const char *data)
{
	if (!hist || !label || !data) {
		return -EINVAL;
	}

	if (strncmp(label, TIC_LABEL_ADCO, TIC_LABEL_SIZE(TIC_LABEL_ADCO)) == 0) {
		memcpy(hist->adco, data, TIC_ADCO_DATA_LEN);
	} else if (strncmp(label, TIC_LABEL_ISOUSC, TIC_LABEL_SIZE(TIC_LABEL_ISOUSC)) == 0) {
		hist->isousc = (uint16_t)strtoul(data, NULL, 10);
	} else if (strncmp(label, TIC_LABEL_BASE, TIC_LABEL_SIZE(TIC_LABEL_BASE)) == 0) {
		hist->base = (uint32_t)strtoul(data, NULL, 10);
	} else if (strncmp(label, TIC_LABEL_PTEC, TIC_LABEL_SIZE(TIC_LABEL_PTEC)) == 0) {
		hist->ptec = (uint16_t)strtoul(data, NULL, 10);
	} else if (strncmp(label, TIC_LABEL_IINST, TIC_LABEL_SIZE(TIC_LABEL_IINST)) == 0) {
		hist->iinst = (uint16_t)strtoul(data, NULL, 10);
	} else if (strncmp(label, TIC_LABEL_IMAX, TIC_LABEL_SIZE(TIC_LABEL_IMAX)) == 0) {
		hist->imax = (uint16_t)strtoul(data, NULL, 10);
	} else if (strncmp(label, TIC_LABEL_PAPP, TIC_LABEL_SIZE(TIC_LABEL_PAPP)) == 0) {
		hist->papp = (uint16_t)strtoul(data, NULL, 10);
	} else if (strncmp(label, TIC_LABEL_OPTARIF, TIC_LABEL_SIZE(TIC_LABEL_OPTARIF)) ==
			   0) {
		if (strcmp(data, TIC_HIST_DATA_OPTARIF_EXPECTED) != 0) {
			return -ENOTSUP; // Unsupported OPTARIF value
		}
	} else if (strncmp(label, TIC_LABEL_HHPHC, TIC_LABEL_SIZE(TIC_LABEL_HHPHC)) == 0) {
		if (strcmp(data, TIC_HIST_DATA_HHPHC_EXPECTED) != 0) {
			return -ENOTSUP; // Unsupported HHPHC value
		}
	} else if (strncmp(label, TIC_LABEL_MOTDETAT, TIC_LABEL_SIZE(TIC_LABEL_MOTDETAT)) ==
			   0) {
		if (strcmp(data, TIC_HIST_DATA_MOTDETAT_EXPECTED) != 0) {
			return -ENOTSUP; // Unsupported MOTDETAT value
		}
	} else {
		return -ENOTSUP; // Unknown label
	}

	return 0;
}
```

## src/tic_demo.c
```c
#include "zephyr/kernel.h"

#include <stddef.h>

extern const unsigned char tic_demo_data[];
extern unsigned int tic_demo_data_len;
extern struct ring_buf uart_rx_ringbuf;
extern struct k_sem rx_data_sem;

void tic_demo_thread(void *p1, void *p2, void *p3);

K_THREAD_DEFINE(
	tic_demo_thread_id, 1024, tic_demo_thread, NULL, NULL, NULL, K_PRIO_PREEMPT(7), 0, 0);

#define DATARATE 100
#define SLEEP_MS 100

void tic_demo_thread(void *p1, void *p2, void *p3)
{
	uint32_t cursor = 0;

	for (;;) {
		uint32_t to_send = (DATARATE * SLEEP_MS) / 1000;

		size_t remaining = tic_demo_data_len - cursor;
		if (remaining >= to_send) {
			ring_buf_put(&uart_rx_ringbuf, &tic_demo_data[cursor], to_send);
			cursor += to_send;
		} else {
			ring_buf_put(&uart_rx_ringbuf, &tic_demo_data[cursor], remaining);
			to_send -= remaining;
			ring_buf_put(&uart_rx_ringbuf, &tic_demo_data[0], to_send);
			cursor = to_send;
		}

		k_sem_give(&rx_data_sem);

		k_sleep(K_MSEC(SLEEP_MS));
	}
}
```
